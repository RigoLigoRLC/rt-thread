## bsp/loongson/ls2k0300/Kconfig
```kconfig
mainmenu "RT-Thread Configuration"

BSP_DIR := .

RTT_DIR := ../../../

PKGS_DIR := packages

source "$(RTT_DIR)/Kconfig"
osource "$PKGS_DIR/Kconfig"
rsource "driver/Kconfig"

config SOC_LS2K0300
    bool
    select ARCH_LOONGARCH64
    select RT_USING_COMPONENTS_INIT
    select RT_USING_USER_MAIN
    select RT_USING_CACHE
    select ARCH_MM_MMU
    select ARCH_REMAP_KERNEL
    select ARCH_LOONGARCH_FPU
    default y

config __STACKSIZE__
    int "stack size for interrupt"
    default 4096
```
